## conf/layer.conf
```bitbake
# We have a conf and classes directory, add to BBPATH
BBPATH .= ":${LAYERDIR}"

# We have recipes-* directories, add to BBFILES
BBFILES += "${LAYERDIR}/recipes-*/*/*.bb \
	${LAYERDIR}/recipes-*/*/*.bbappend"

BBFILE_COLLECTIONS += "clegg"
BBFILE_PATTERN_clegg = "^${LAYERDIR}/"
BBFILE_PRIORITY_clegg = "6"

LAYERDEPENDS_clegg = "core raspberrypi"
```
